## boards/shields/AdeptBLE/Kconfig.defconfig
```kconfig
if SHIELD_ADEPTBLE

config ZMK_KEYBOARD_NAME
    default "AdeptBLE"

endif

config SPI
	default y
```

## config/boards/shields/adept_ble/Kconfig.defconfig
```kconfig
if SHIELD_ADEPT_BLE

config ZMK_KEYBOARD_NAME
    default "adept_ble"

endif

config SPI
	default y
```

## config/boards/shields/mouse-test/Kconfig.defconfig
```kconfig
if SHIELD_MOUSE_TEST

config ZMK_KEYBOARD_NAME
    default "mouse_test"

endif

config SPI
	default y
```

## config/west.yml
```yaml
manifest:
  remotes:
    - name: zmkfirmware
      url-base: https://github.com/zmkfirmware
    - name: badjeff
      url-base: https://github.com/badjeff
    # - name: cyboard
    #   url-base: https://github.com/Cyboard-DigitalTailor
  projects:
    - name: zmk
      remote: zmkfirmware
      revision: v0.3
      import: app/west.yml
    - name: zmk-pmw3610-driver
      remote: badjeff
      revision: zmk-0.3
    # - name: zmk-pmw3610-driver
    #   remote: cyboard
    #   revision: startup_optimization
  self:
    path: config
```
